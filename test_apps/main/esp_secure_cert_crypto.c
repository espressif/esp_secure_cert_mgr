#include <string.h>
#include <inttypes.h>
#include "esp_log.h"
#include "esp_secure_cert_tlv_private.h"


#define TAG "esp_secure_cert_crypto_test"

void esp_secure_cert_crypto_test()
{
    // 25e242394a6acc0f8853a74398806f1c6045dfb3a2c5173f4be52ad840ea611d
    char in_buf[32] = {0x25, 0xE2, 0x42, 0x39, 0x4A, 0x6A, 0xCC, 0x0F, 0x88, 0x53, 0xA7, 0x43, 0x98, 0x80, 0x6F, 0x1C,
    0x60, 0x45, 0xDF, 0xB3, 0xA2, 0xC5, 0x17, 0x3F, 0x4B, 0xE5, 0x2A, 0xD8, 0x40, 0xEA, 0x61, 0x1D};
    char expected_output_buf[32] = {0x00, 0x01, 0x02, 0x03, 0x04, 0x05, 0x06, 0x07, 0x08, 0x09, 0x0A, 0x0B, 0x0C, 0x0D, 0x0E, 0x0F,
        0x00, 0x01, 0x02, 0x03, 0x04, 0x05, 0x06, 0x07, 0x08, 0x09, 0x0A, 0x0B, 0x0C, 0x0D, 0x0E, 0x0F};
    char output_buf[32] = {0};
    // 0123456789ABCDEF0123456789ABCDEF
    uint8_t key[32] = { 0x00, 0x01, 0x02, 0x03, 0x04, 0x05, 0x06, 0x07, 0x08, 0x09, 0x0A, 0x0B, 0x0C, 0x0D, 0x0E, 0x0F,
        0x00, 0x01, 0x02, 0x03, 0x04, 0x05, 0x06, 0x07, 0x08, 0x09, 0x0A, 0x0B, 0x0C, 0x0D, 0x0E, 0x0F};    
    uint8_t iv[16] = {0x00, 0x01, 0x02, 0x03, 0x04, 0x05, 0x06, 0x07, 0x08, 0x09, 0x0A, 0x0B, 0x0C, 0x0D, 0x0E, 0x0F};
    // 939c4ec3f9ce7eaf87c3d7c2357c66d3
    uint8_t tag[16] = {0x93, 0x9C, 0x4E, 0xC3, 0xF9, 0xCE, 0x7E, 0xAF, 0x87, 0xC3, 0xD7, 0xC2, 0x35, 0x7C, 0x66, 0xD3};
    // uint8_t aad[16] = {0x00, 0x01, 0x02, 0x03, 0x04, 0x05, 0x06, 0x07, 0x08, 0x09, 0x0A, 0x0B, 0x0C, 0x0D, 0x0E, 0x0F};
    size_t key_len = 32;
    size_t tag_len = 16;
    esp_err_t esp_ret = esp_secure_cert_crypto_gcm_decrypt(in_buf, 32, output_buf, key, key_len, iv, NULL, tag, tag_len);
    if (esp_ret != ESP_OK) {
        ESP_LOGE(TAG, "Failed to decrypt the data");
        return;
    }
    int ret = memcmp(expected_output_buf, output_buf, 32);
    if (ret != 0) {
        ESP_LOGE(TAG, "Failed to decrypt the data");
        return;
    }
}

const char expected_der_ecdsa_key_buf[ESP_SECURE_CERT_ECDSA_DER_KEY_SIZE] = {0x30, 0x77, 0x02, 0x01, 0x01, 0x04, 0x20, 0x00, 0x01, 0x02, 0x03, 0x04, 0x05,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 0x4B, 0x21};

void esp_secure_cert_crypto_convert_key_to_der_test()
{
    char ecdsa_key_buf[32] = {0x00, 0x01, 0x02, 0x03, 0x04, 0x05, 0x06, 0x07, 0x08, 0x09, 0x0A, 0x0B, 0x0C, 0x0D, 0x0E, 0x0F,
        0x00, 0x01, 0x02, 0x03, 0x04, 0x05, 0x06, 0x07, 0x08, 0x09, 0x0A, 0x0B, 0x0C, 0x0D, 0x0E, 0x0F};
    char *der_ecdsa_key_buf = (char *)malloc(ESP_SECURE_CERT_ECDSA_DER_KEY_SIZE);
    if (der_ecdsa_key_buf == NULL) {
        ESP_LOGE(TAG, "Failed to allocate memory");
        return;
    }
    esp_err_t esp_ret = esp_secure_cert_convert_key_to_der(ecdsa_key_buf, 32, der_ecdsa_key_buf, ESP_SECURE_CERT_ECDSA_DER_KEY_SIZE);
    if (esp_ret != ESP_OK) {
        ESP_LOGE(TAG, "Failed to convert the key to der");
        return;
    }
    int ret = memcmp(expected_der_ecdsa_key_buf, der_ecdsa_key_buf, ESP_SECURE_CERT_ECDSA_DER_KEY_SIZE);
    if (ret != 0) {
        ESP_LOGE(TAG, "Failed to convert the key to der");
        return;
    }
    ESP_LOGI(TAG, "Successfully converted the key to der");
}
