## Kconfig
```kconfig
menu "ESP Secure Cert Manager"

    config ESP_SECURE_CERT_DS_PERIPHERAL
        bool "Enable DS peripheral support"
        default y
        depends on SOC_DIG_SIGN_SUPPORTED
        help
            Enable the DS peripheral support. Not supported on targets that do not support Digital Signature peripheral

    config ESP_SECURE_CERT_SUPPORT_LEGACY_FORMATS
        bool "Enable support for legacy formats"
        default n
        help
            This option enables support for the legacy formats along with
            the current format in the esp_secure_cert component.
            The current format is
            cust_flash_tlv
            The legacy formats are as follows:
            cust_flash
            nvs

endmenu # ESP Secure Cert Manager
```

## examples/esp_secure_cert_app/main/Kconfig.projbuild
```kconfig
menu "Example Configuration"

config EXAMPLE_ESP_SECURE_CERT_ENABLE_CI
    bool
    default n
    help
        Enable this option to apply configuration settings required for running
        the esp_secure_cert example in Continuous Integration (CI) environments.
        This may include settings for automated testing, mock data, or other
        CI-specific behaviors. It is not intended for production use.

endmenu
```

## examples/esp_secure_cert_app/sdkconfig.defaults
```kconfig
CONFIG_PARTITION_TABLE_CUSTOM=y
CONFIG_PARTITION_TABLE_OFFSET=0xD000
CONFIG_PARTITION_TABLE_CUSTOM_FILENAME="partitions_custflash_esp32.csv"
```

## examples/esp_secure_cert_ota_example/main/Kconfig.projbuild
```kconfig
menu "ESP Secure Cert OTA Example Configuration"

    choice EXAMPLE_ESP_SECURE_CERT_OTA_MODE
        prompt "ESP Secure Cert OTA Mode"
        default EXAMPLE_ESP_SECURE_CERT_OTA_USE_UNALLOCATED_SPACE
        help
            Select the OTA mode for esp_secure_cert partition updates.

        config EXAMPLE_ESP_SECURE_CERT_OTA_USE_UNALLOCATED_SPACE
            bool "Use Unallocated Space"
            help
                Find unallocated space in flash and use it as staging area.
                After successful download, copy to original partition.
                Uses NVS to track staging offset during download.

        config EXAMPLE_ESP_SECURE_CERT_USE_PASSIVE_OTA
            bool "Use Passive OTA Partition"
            help
                Use the passive OTA app partition as staging area.
                Validates that partition has no valid image before using.
                After successful download, copy to original partition.

        config EXAMPLE_ESP_SECURE_CERT_DIRECT_OTA
            bool "Direct OTA"
            help
                Perform OTA directly on the original esp_secure_cert partition.
                WARNING: This mode is risky as interruption will corrupt the partition.
                No staging area or rollback capability.

    endchoice

    config EXAMPLE_USE_SIMULATED_OTA
        bool "Use simulated OTA data (no network download)"
        default n
        help
            When enabled, uses simulated certificate data instead of downloading from network.
            Useful for testing OTA mechanisms without requiring WiFi or a server.
            When disabled, will download from the URL specified below.

    config EXAMPLE_WIFI_SSID
        string "WiFi SSID"
        default "myssid"
        depends on !EXAMPLE_USE_SIMULATED_OTA
        help
            SSID (network name) to connect to.

    config EXAMPLE_WIFI_PASSWORD
        string "WiFi Password"
        default "mypassword"
        depends on !EXAMPLE_WIFI_SSID
        help
            WiFi password (WPA or WPA2) to use.

    config EXAMPLE_CERT_OTA_URL
        string "ESP Secure Cert OTA URL"
        default "http://192.168.1.100:8000/esp_secure_cert.bin"
        depends on !EXAMPLE_USE_SIMULATED_OTA
        help
            URL of the esp_secure_cert binary file to download.
            Examples:
              http://192.168.1.100:8000/esp_secure_cert.bin
              https://your-server.com/certs/esp_secure_cert.bin

            To serve file locally:
              python3 -m http.server 8000
            Then use: http://<your-pc-ip>:8000/esp_secure_cert.bin

    config EXAMPLE_CERT_OTA_URL_USE_HTTPS
        bool "Use HTTPS for OTA URL"
        default n
        depends on !EXAMPLE_USE_SIMULATED_OTA
        help
            Enable if your OTA URL uses HTTPS.
            You may need to provide server certificate for validation.

    config EXAMPLE_OTA_RECV_TIMEOUT
        int "OTA receive timeout (ms)"
        default 5000
        help
            Maximum time for receiving OTA data (in milliseconds).

endmenu
```

## examples/esp_secure_cert_ota_example/sdkconfig.defaults
```kconfig
# Enable OTA functionality
CONFIG_BOOTLOADER_APP_ROLLBACK_ENABLE=y
CONFIG_APP_PROJECT_VER_FROM_CONFIG=y
CONFIG_APP_PROJECT_VER="1.0.0"

# Enable NVS
CONFIG_NVS_ENCRYPTION=n

# Enable secure cert manager
CONFIG_ESP_SECURE_CERT_SUPPORT_LEGACY_FORMATS=n

# Enable OTA data partition
CONFIG_PARTITION_TABLE_CUSTOM=y
CONFIG_PARTITION_TABLE_CUSTOM_FILENAME="partitions.csv"

# Default OTA mode - Use Unallocated Space
CONFIG_EXAMPLE_ESP_SECURE_CERT_OTA_USE_UNALLOCATED_SPACE=y

# OTA timeout
CONFIG_EXAMPLE_OTA_RECV_TIMEOUT=5000
CONFIG_ESP_HTTPS_OTA_ALLOW_HTTP=y
# WiFi Configuration (used when CONFIG_EXAMPLE_USE_SIMULATED_OTA=n)
# CONFIG_EXAMPLE_WIFI_SSID="ESP_India"
# CONFIG_EXAMPLE_WIFI_PASSWORD="Esp@3101"
# CONFIG_EXAMPLE_CERT_OTA_URL="http://192.168.21.56:8000/esp_secure_cert.bin"
```

## examples/esp_secure_cert_ota_example/sdkconfig.defaults.passive_ota
```kconfig
# Configuration for Passive OTA Partition Mode
# To use: cp sdkconfig.defaults.passive_ota sdkconfig.defaults

# Enable OTA functionality
CONFIG_BOOTLOADER_APP_ROLLBACK_ENABLE=y
CONFIG_APP_PROJECT_VER_FROM_CONFIG=y
CONFIG_APP_PROJECT_VER="1.0.0"

# Enable NVS
CONFIG_NVS_ENCRYPTION=n

# Enable secure cert manager
CONFIG_ESP_SECURE_CERT_SUPPORT_LEGACY_FORMATS=n

# Enable OTA data partition
CONFIG_PARTITION_TABLE_CUSTOM=y
CONFIG_PARTITION_TABLE_CUSTOM_FILENAME="partitions.csv"

# OTA Mode: Use Passive OTA Partition
CONFIG_EXAMPLE_ESP_SECURE_CERT_USE_PASSIVE_OTA=y

# OTA timeout
CONFIG_EXAMPLE_OTA_RECV_TIMEOUT=5000
```

## test_apps/main/Kconfig.projbuild
```kconfig
menu "Test Apps Configuration"

    config TEST_ESP_SECURE_CERT_TLV_LEGACY
        bool "Test TLV and legacy format operations"
        default n
        help
            Enable this option to test the TLV and legacy format operations

    config TEST_ESP_SECURE_CERT_CRYPTO
        bool "Test cryptographic operations"
        default n
        help
            Enable this option to test the cryptographic operations

    config TEST_ESP_SECURE_CERT_BASICS
        bool "Test basic operations"
        default n
        help
            Enable this option to test the basic operations

    config UNITY_FREERTOS_STACK_SIZE
        int "Stack size for the test task"
        default 8192
        help
            Set the stack size for the test task

endmenu
```
